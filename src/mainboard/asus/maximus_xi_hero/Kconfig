## src/mainboard/asus/maximus_xi_hero/Kconfig
```kconfig
## SPDX-License-Identifier: GPL-2.0-or-later

if BOARD_ASUS_MAXIMUS_XI_HERO

config BOARD_SPECIFIC_OPTIONS
	def_bool y
	select BOARD_ROMSIZE_KB_16384
	select MAINBOARD_USES_IFD_GBE_REGION
	select SPD_READ_BY_WORD
	select SUPERIO_NUVOTON_NCT6798D
	#select MAINBOARD_HAS_LIBGFXINIT
	select INTEL_GMA_HAVE_VBT
	select HAVE_ACPI_RESUME
	select HAVE_ACPI_TABLES
	#select HAVE_OPTION_TABLE
	select NO_UART_ON_SUPERIO
	select SOC_INTEL_CANNONLAKE_PCH_H
	select SOC_INTEL_COFFEELAKE
	select SOC_INTEL_COMMON_BLOCK_HDA_VERB

config MAINBOARD_DIR
	default "asus/maximus_xi_hero"

config MAINBOARD_PART_NUMBER
	default "Maximus XI Hero"

config D3COLD_SUPPORT
	default n

config MAX_CPUS
	default 16

endif
```

## src/mainboard/asus/maximus_xi_hero/Kconfig.name
```kconfig
## SPDX-License-Identifier: GPL-2.0-only

config BOARD_ASUS_MAXIMUS_XI_HERO
	bool "Maximus XI Hero"
```
